## config/west.yml
```yaml
manifest:
  remotes:
    - name: zmkfirmware
      url-base: https://github.com/zmkfirmware
    - name: edysantosa
      url-base: https://github.com/rizalfr
  projects:
    - name: zmk
      remote: rizalfr
      revision: jaykeeb
      import: app/west.yml
  self:
    path: config
```
